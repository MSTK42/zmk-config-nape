## config/west.yml
```yaml
manifest:
  remotes:
    - name: zmkfirmware
      url-base: https://github.com/zmkfirmware
    - name: menbou0202
      url-base: https://github.com/menbou0202
    - name: caksoylar
      url-base: https://github.com/caksoylar
    - name: kumamuk-git
      url-base: https://github.com/kumamuk-git
    - name: inorichi
      url-base: https://github.com/inorichi
    - name: kot149
      url-base: https://github.com/kot149
    # Additional modules containing boards/shields/custom code can be listed here as well
    # See https://docs.zephyrproject.org/3.2.0/develop/west/manifest.html#projects

  projects:
    - name: zmk
      remote: zmkfirmware
      revision: main
      import: app/west.yml
    - name: zmk-pmw3610-driver
      remote: kumamuk-git
      revision: main
    - name: zmk-rgbled-widget
      remote: caksoylar
      revision: main
    - name: zmk-mouse-gesture
      remote: kot149
      revision: v1

  self:
    path: config
```
