/ {
    split_inputs {
        #address-cells = <1>;
        #size-cells = <0>;

        tb_split: tb_split@0 {
            compatible = "zmk,input-split";
            reg = <0>;
        };
    };

    tb_listener: tb_listener {
        compatible = "zmk,input-listener";
        status = "disabled";
        device = <&tb_split>;
    };
};
